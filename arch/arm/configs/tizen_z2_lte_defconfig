## drivers/gpu/arm/mali400/Kconfig
```kconfig
menuconfig MALI400
	bool "Mali-400 support"
	depends on ARM
	default n
	select DMA_SHARED_BUFFER
	---help---
	  This enables support for the ARM Mali-400 GPU.

choice
depends on MALI400
prompt "Select MALI VER"
default MALI_VER_R4P0_REL0

config MALI_VER_R4P0_REL0
	bool "Mali400 Version R4P0-REL0"
	help
	  Choose this option to select DDK version.

if MALI_VER_R4P0_REL0
source "drivers/gpu/arm/mali400/r4p0_rel0/Kconfig"
endif

config MALI_VER_R5P0_REL0
	bool "Mali400 Version R5P0-REL0"
	help
	  Choose this option to select DDK version.

if MALI_VER_R5P0_REL0
source "drivers/gpu/arm/mali400/r5p0_rel0/Kconfig"
endif

endchoice
```

## drivers/gpu/drm/sprd/Kconfig
```kconfig
config DRM_SPRD
	tristate "DRM Support for Spreadtrum SoC SPRD Series"
	depends on DRM
	select FB_CFB_FILLRECT
	select FB_CFB_COPYAREA
	select FB_CFB_IMAGEBLIT
	select VT_HW_CONSOLE_BINDING if FRAMEBUFFER_CONSOLE
	help
	  Choose this option if you have a Spreadtrum SoC SPRD chipset.
	  If M is selected the module will be called sprddrm.

config DRM_SPRD_DMABUF
	bool "SPRD DRM DMABUF"
	depends on DRM_SPRD
	help
	  Choose this option if you want to use DMABUF feature for DRM.

config DRM_SPRD_IPP
	bool "SPRD DRM IPP"
	depends on DRM_SPRD
	help
	  Choose this option if you want to use IPP feature for DRM.

config DRM_SPRD_GSP
	bool "SPRD DRM GSP"
	depends on DRM_SPRD_IPP
	help
	  Choose this option if you want to use SPRD GSP for DRM.

config DRM_DPMS_IOCTL
	bool "DRM DPMS IOCTL"
	depends on DRM_SPRD
	help
	  Choose this option if you want to use drm dpms ioctl.
```

## drivers/media/radio/sc2331/Kconfig
```kconfig
#
#  SPRD SC2331 V4l2 driver.
#
menu "SC2331 FM driver (V4L2 based)"
config RADIO_SC2331
	tristate "Spreadtrum SC2331 FM Radio"
	depends on VIDEO_V4L2

	help
	Choose Y here if you have this FM radio chip.

	In order to control your radio card, you will need to use programs
	that are compatible with the Video For Linux 2 API.  Information on
	this API and pointers to "v4l2" programs may be found at
	<file:Documentation/video4linux/API.html>.

endmenu
```

## drivers/misc/clkmon/Kconfig
```kconfig
config CLK_MON
       bool "Clock Gate Mornitor"
       depends on ARCH_SCX35=y
       default y
       help
               Say Y to here to enable Clock Gate Mornitor driver for
               profiling Clock Gating and Power Domains.
```

## drivers/motor/Kconfig
```kconfig
config FF_DC_VIBRATOR
	tristate "FF_DC_VIBRATOR"
	default n
	help
	 Say Y to enable ff dc vibrator
```
